#include "stm32f10x.h"
#include "LCD5110.h"
#include "delay.h"
#include "Pixel_EN.h"
#include "Pixel_CH.h"
//-------------------------------------------------------------------
//	Nokia5510指令集
//  D7  D6  D5  D4  D3  D2  D1  D0
//  0   0   1   0   0   PD  V   H
//                      |   |   |_______1->扩展指令集  0->基本指令集
//                      |   |___________1->垂直寻址    0->水平寻址 
//                      |_______________1->低功耗模式  0->正常模式
//-------------------------------------------------------------------
//	显示模式
//  D7  D6  D5  D4  D3  D2  D1  D0
//  0   0   0   0   1   D   0   E
//                      |       |_______0    0    1    1
//                      |_______________0    1    0    1
//                                      白屏 正常 全显 反转
//-------------------------------------------------------------------

//横纵坐标范围分别为：X   0~~78 (一个字符x方向占大约6个单位);Y  0~~5（一个字符y方向占1各单位）

/********************************************************************************************************************************************
@f_name: void LCD5110_GPIOInit(void)
@brief:	 初始化硬件端口配置
@param:	 None
@return: None
*********************************************************************************************************************************************/
void LCD5110_GPIOInit(void)
{
	GPIO_InitTypeDef GPIO_InitStructure;
 	RCC_APB2PeriphClockCmd(LCDRCC_CLK, ENABLE);

	GPIO_InitStructure.GPIO_Pin =LCD_RST|LCD_CE|LCD_DC|LCD_MOSI|LCD_CLK;
 	GPIO_InitStructure.GPIO_Speed = GPIO_Speed_50MHz;
 	GPIO_InitStructure.GPIO_Mode = GPIO_Mode_Out_PP;
 	GPIO_Init(LCD_CTRL_PORT, &GPIO_InitStructure);

	LCD5110_Init();
	LCD5110Clear();
}
/********************************************************************************************************************************************
@f_name: void LCD5110_Init(void)
@brief:	 液晶初始化
@param:	 None
@return: None
*********************************************************************************************************************************************/
void LCD5110_Init(void)
{
	//复位LCD_低电平脉冲
	LCD_RST_L;		
	delay_ms(1);
	LCD_RST_H;
	
	//复位串行接口_高电平脉冲
	LCD_CE_H; 
	delay_ms(1);
	LCD_CE_L; 

	//设置LCD
    LCD5110_Send(0x21, DC_CMD);	//使用扩展命令设置LCD模式
    LCD5110_Send(0xC8, DC_CMD);	//设置偏置电压
    LCD5110_Send(0x06, DC_CMD);	//温度校正
    LCD5110_Send(0x13, DC_CMD);	//1:48
    LCD5110_Send(0x20, DC_CMD);	//使用基本命令
    LCD5110_Send(0x0C, DC_CMD);	//设定显示模式，正常显示

	LCD5110_SetContrast(68);    //对比度为68
}
/********************************************************************************************************************************************
@f_name: void LCD5110_SetContrast(u8 contrast)
@brief:	 设置LCD对比度(对比度范围: 0~127)
@param:	 None
@return: None
*********************************************************************************************************************************************/
void LCD5110_SetContrast(u8 contrast)
{
    LCD5110_Send(0x21, DC_CMD);
    LCD5110_Send(0x80 | contrast, DC_CMD);
    LCD5110_Send(0x20, DC_CMD);
}
/********************************************************************************************************************************************
@f_name: void LCD5110_SetXY(u8 X, u8 Y)
@brief:	 设置LCD当前坐标	  
@param:	 X:0~83   Y:1~5  
@return: None
*********************************************************************************************************************************************/
void LCD5110_SetXY(u8 X, u8 Y)
{
	if(X>83) X=83;
	if(Y>5)	 Y=5;
	LCD5110_Send(0x40 | Y, DC_CMD);    // 行
    LCD5110_Send(0x80 | X, DC_CMD);    // 列
}
/********************************************************************************************************************************************
@f_name: void LCD5110Clear(void)
@brief:	 LCD全部清屏
@param:	 None
@return: None
*********************************************************************************************************************************************/
void LCD5110Clear(void)
{
	u16 i;	
	LCD5110_Send(0x0c, DC_CMD);
    LCD5110_Send(0x80, DC_CMD);	
	for (i=0; i<504; i++)
	LCD5110_Send(0, DC_DATA);	
}
/********************************************************************************************************************************************
@f_name: void LCD5110ClearPart(u8 X,u8 Y,u8 L,u8 H)
@brief:	 LCD部分清屏
@param:	 u8 X,u8 Y,        u8 L,       u8 H
@return: None
*********************************************************************************************************************************************/
void LCD5110ClearPart(u8 X,u8 Y,u8 L,u8 H)
{
	u16 i,j;
	
	LCD5110_Send(0x0c, DC_CMD);
    LCD5110_Send(0x80, DC_CMD);
	
	for (i=Y; i<Y+H+1; i++)
    	for(j=X;j<X+L+1;j++)
         { 
					LCD5110_SetXY(j,i);
					LCD5110_Send(0, DC_DATA);	
         }
}
/********************************************************************************************************************************************
@f_name: void LCD5110_Send(u8 data, DCType dc)
@brief:	  向LCD发送数据
@param:	 u8 data:数据          DCType dc	  DC_CMD  = 0,	//写命令	DC_DATA = 1		//写数据
@return: None
*********************************************************************************************************************************************/
void LCD5110_Send(u8 data, DCType dc)
{
	u8 i=8;

	if (dc==DC_CMD)
		LCD_DC_CMD;	//发送命令
	else
		LCD_DC_DATA;//发送数据
	
//	LCD_CE_L; //Enable LCD
	
	while (i--)
	{
		LCD_CLK_L;
		if(data&0x80)
			LCD_MOSI_H;	/* MSB first */
		else 
			LCD_MOSI_L;
		LCD_CLK_H;
		data <<= 1;		/* Data shift */
	}
	
//	LCD_CE_H; //Disable LCD
}
/********************************************************************************************************************************************
@f_name: void LCD5110WriteChar(u8 X, u8 Y,u8 ascii)
@brief:	 向LCD写一个英文字符
@param:	 u8 X, u8 Y,                u8 ascii:英文ASCII编码
@return: None
*********************************************************************************************************************************************/
void LCD5110WriteChar(u8 X, u8 Y,u8 ascii)
{   
  u8 n;
	LCD5110_SetXY(X,Y);
	ascii -= 32; //ASCII码-32

	for (n=0; n<7; n++)
	LCD5110_Send(Font6x8[ascii][n], DC_DATA);
}

/*
void LCD_Write_Char(u8 ascii)
{
    u8 n;
	
    ascii -= 32; //ASCII码-32
	
    for (n=0; n<6; n++)
		LCD_Send(Font6x8[ascii][n], DC_DATA);
}
*/
/********************************************************************************************************************************************
@f_name: void LCD5110WriteEnStr(u8 X, u8 Y, u8* s)
@brief:	 向LCD写英文字符串
@param:	 u8 X:0~83       u8 Y:0~5            u8* s:字符串
@return: None
*********************************************************************************************************************************************/
void LCD5110WriteEnStr(u8 X, u8 Y, u8* s)
{
    while (*s!='\0') 
	{
		LCD5110WriteChar(X,Y,*s++);
		X=X+6;
		if(X>84)
		{ 
			X=0;
			Y=Y+1;
			*s--;
			if(Y>5)	{Y=0;}
		}
	}
}
/********************************************************************************************************************************************
@f_name: void LCD5110ShowNum(u8 X,u16 Y,u32 num)
@brief:	 显示一个数字
@param:	 x,y:起点坐标		 num:数值(0~2^32); 
@return: None
*********************************************************************************************************************************************/
//m^n函数
u32 mypow(u8 m,u8 n)
{
	u32 result=1;	 
	while(n--)result*=m;    
	return result;
}
void LCD5110ShowNum(u8 X,u16 Y,u32 num)
{      
	u32 res;   	   
	u8 t=0,t1=0;   
	res=num;
	if(!num)LCD5110WriteChar( X,Y,'0');//显示0
	while(res)  //得到数字长度
	{
		res/=10;
		t++;
	}
	t1=t;
	while(t)	//显示数字
	{
		res=mypow(10,t-1); 	 
	  LCD5110WriteChar(X+(t1-t)*6,Y,(num/res)%10+'0');//数字字符第一个在'0'之前
		t--;
	}				     
} 
/********************************************************************************************************************************************
@f_name: void LCD5110WriteChStr(u8 X, u8 Y,u8 n)
@brief:	 向LCD写中文字符串
@param:	 u8 X, u8 Y:液晶字符位置坐标   u8 n：汉字位置顺序
@return: None
*********************************************************************************************************************************************/
void LCD5110WriteChStr(u8 X, u8 Y,u8 n)
{
	int i;
	LCD5110_SetXY(X,Y);
	for(i = 0;i < 12; i++)//汉字上半身
	{
		LCD5110_Send(chinese_character[n][i],DC_DATA);
	}
	LCD5110_SetXY(X,Y+1);
	for(i = 12; i < 24; i++)//汉字下半身
	{LCD5110_Send(chinese_character[n][i],DC_DATA);}
}
	
